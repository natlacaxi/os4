## 01_KERNEL/configuration/talco_defconfig
```kconfig
CONFIG_ARM64=y
CONFIG_SMP=y
CONFIG_PREEMPT=y
CONFIG_CGROUPS=y
CONFIG_NAMESPACES=y
CONFIG_SECURITY_SELINUX=y
CONFIG_DM_VERITY=y
CONFIG_WIREGUARD=y
CONFIG_BT=y
CONFIG_CFG80211=y
CONFIG_USB_GADGET=y
```
